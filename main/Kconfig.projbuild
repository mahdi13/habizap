## main/Kconfig.projbuild
```kconfig
menu "HabiZap Configuration"

    config HABIZAP_I2C_MASTER_SCL
        int "I2C SCL GPIO Num"
        default 5
        help
            GPIO number for I2C Master clock line.

    config HABIZAP_I2C_MASTER_SDA
        int "I2C SDA GPIO Num"
        default 4
        help
            GPIO number for I2C Master data line.

    config HABIZAP_I2C_MASTER_FREQUENCY
        int "I2C Master Frequency"
        default 400000
        help
            I2C Speed of Master device.

    # Vibration output configuration
    config HABIZAP_VIBRATION_GPIO
        int "Vibration GPIO"
        default 2
        help
            GPIO used to drive the vibration motor/module (via transistor/driver).
            Compatible with Grove and generic modules. Wire VCC and GND per module, and use this GPIO as SIG.

    config HABIZAP_VIBRATION_ACTIVE_HIGH
        bool "Vibration Active High"
        default y
        help
            If enabled, driving the GPIO HIGH turns the motor ON. Disable for active-low drivers.

    config HABIZAP_VIBRATION_QUEUE_LEN
        int "Vibration Queue Length"
        default 8
        range 1 64
        help
            How many vibration pattern commands can be queued.

    # a config to set whether to run in training mode or not
    choice HABIZAP_TRAINING_MODE
        bool "Training Mode"
        default HABIZAP_TRAINING_MODE_ON
        help
            Enable or disable training mode.
            In training mode, the device will not perform its normal functions,
            but will instead allow the user to train it to recognize new gestures.
        config HABIZAP_TRAINING_MODE_ON
            bool "Enable Training Mode"
        config HABIZAP_TRAINING_MODE_OFF
            bool "Disable Training Mode"
    endchoice


    # Battery monitoring configuration
    menu "Battery Monitoring"
        config HABIZAP_BATTERY_ENABLE
            bool "Enable Battery Monitoring"
            default y
            help
                Enable background task that reads ADC and estimates battery percentage.

        config HABIZAP_BATTERY_ADC_UNIT
            int "ADC Unit (1 or 2)"
            range 1 2
            default 1
            help
                Select ADC unit to use.

        config HABIZAP_BATTERY_ADC_CHANNEL
            int "ADC Channel Number"
            range 0 9
            default 0
            help
                ADC channel index for the selected unit.

        config HABIZAP_BATTERY_ADC_ATTEN_DB
            int "ADC Attenuation (dB)"
            default 11
            help
                ADC attenuation in dB. Common values: 0, 2 (2.5dB), 6, 11.

        config HABIZAP_BATTERY_DIVIDER_R1_OHMS
            int "Divider R1 (ohms)"
            default 100000
            help
                Upper resistor from battery+ to sense node.

        config HABIZAP_BATTERY_DIVIDER_R2_OHMS
            int "Divider R2 (ohms)"
            default 100000
            help
                Lower resistor from sense node to GND.

        config HABIZAP_BATTERY_EMPTY_MV
            int "Battery Empty Voltage (mV)"
            default 3300
            help
                Voltage considered 0%%. For single-cell LiPo usually ~3300mV under light load.

        config HABIZAP_BATTERY_FULL_MV
            int "Battery Full Voltage (mV)"
            default 4200
            help
                Voltage considered 100%%. For single-cell LiPo 4.2V.

        config HABIZAP_BATTERY_SAMPLE_COUNT
            int "Samples per Reading"
            range 1 128
            default 16
            help
                Number of ADC samples to average each period.

        config HABIZAP_BATTERY_PERIOD_MS
            int "Reading Period (ms)"
            range 100 600000
            default 5000
            help
                Period between background readings.
    endmenu

    # ML configuration
    menu "HabiZap ML (Edge Impulse)"

        config HABIZAP_ML_QUEUE_LEN
            int "Inference queue length"
            range 1 32
            default 4
            help
                Number of pending inference messages in the queue.

        config HABIZAP_ML_USE_CONTINUOUS
            bool "Use continuous classifier (sliding window)"
            default y
            help
                Enable Edge Impulse run_classifier_continuous() with a sliding window.
                When disabled, full frames must be submitted to run_classifier().

        config HABIZAP_ML_POSITIVE_THRESHOLD
            float "Positive threshold"
            default 0.6
            help
                Minimum probability for the positive class to flag is_positive.

        config HABIZAP_ML_POSITIVE_LABEL
            string "Positive label name"
            default "positive"
            help
                Name of the label that should be treated as the positive class.
                Must match one of ei_classifier_inferencing_categories[].

        config HABIZAP_ML_TASK_STACK
            int "Inference task stack (bytes)"
            default 6144
            help
                Stack size used by the inference task.

        config HABIZAP_ML_TASK_PRIORITY
            int "Inference task priority"
            range 1 10
            default 5
            help
                FreeRTOS priority for the inference task (higher = more priority).

    endmenu


endmenu
```

## sdkconfig.defaults
```kconfig
CONFIG_HABIZAP_I2C_MASTER_SCL=5
CONFIG_HABIZAP_I2C_MASTER_SDA=4
CONFIG_HABIZAP_I2C_MASTER_FREQUENCY=400000
CONFIG_HABIZAP_ML_USE_CONTINUOUS=1
```

## sdkconfig.defaults.esp32c6
```kconfig
CONFIG_HABIZAP_I2C_MASTER_SCL=23
CONFIG_HABIZAP_I2C_MASTER_SDA=22
HABIZAP_VIBRATION_GPIO=1
```
